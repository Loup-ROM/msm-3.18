/* Copyright (c) 2018, Eduardo Noyer (bitrvmpd). All rights reserved.
 *
 * This program is free software; you can redistribute it and/or modify
 * it under the terms of the GNU General Public License version 2 and
 * only version 2 as published by the Free Software Foundation.
 *
 * This program is distributed in the hope that it will be useful,
 * but WITHOUT ANY WARRANTY; without even the implied warranty of
 * MERCHANTABILITY or FITNESS FOR A PARTICULAR PURPOSE.  See the
 * GNU General Public License for more details.
 */

/* 
 * Let's change voltages first. -5000 -5000 -5000 -5000
 * 
 * Original values:
 *      regulator-min-microvolt = <1050000>;
 *      regulator-max-microvolt = <1350000>;
 *
 *	qcom,cpr-voltage-ceiling =  <1155000 1225000 1350000>;
 *      qcom,cpr-voltage-floor =    <1150000 1150000 1250000>;
 *      qcom,cpr-init-voltage-ref = <1155000 1225000 1350000>;
 *
 *	regulator-min-microvolt = <1>;
 *	regulator-max-microvolt = <7>;
 *
 *	qcom,cpr-corner-map = <1 2 3 3 3 3 3>;
 *
 */

&pm8937_s5 {
	regulator-min-microvolt = <1050000>;
	regulator-max-microvolt = <1350000>;
};


&apc_vreg_corner {
	qcom,cpr-voltage-ceiling = 	<1155000 1225000 1350000>;
	qcom,cpr-voltage-floor =   	<1150000 1150000 1250000>;
	qcom,cpr-init-voltage-ref = 	<1155000 1225000 1350000>;

	regulator-min-microvolt = <1>;
	regulator-max-microvolt = <9>;


	qcom,cpr-corner-map = <1 1 1 1 1 2 2 2 3>;
    qcom,cpr-corner-frequency-map =
						<1 668000000>,
			            <2 768000000>,
                        <3 960000000>,
                        <4 1094400000>,
                        <5 1209600000>,
                        <6 1248000000>,
                        <7 1344000000>,
                        <8 1401000000>,
                        <9 1497600000>;

};


&clock_cpu {
	qcom,speed0-bin-v0-c0 =
                        <          0 0>,
						/*Mods*/
						<  668000000 1>,
                        <  768000000 2>,
                        <  902400000 3>,
                        <  998400000 4>,
                        < 1094400000 6>;

    qcom,speed0-bin-v0-c1 =
                        <          0 0>,
	                    /*Mods*/
			            <  768000000 1>,
                        <  960000000 2>,
                        < 1094400000 3>,
			            < 1209600000 4>,
                        < 1248000000 5>,
                        < 1344000000 6>,
                        < 1401000000 7>,
	                    /*Mods*/
			            < 1497600000 8>;
};


&msm_cpufreq {
	qcom,cpufreq-table-0 =
   		    <  768000 >,
			<  960000 >,
			< 1094400 >,
			< 1209600 >,
			< 1248000 >,
			< 1344000 >,
			< 1401000 >,
			< 1497600 >;

	qcom,cpufreq-table-4 =
			<  668000 >,
			<  768000 >,
			<  902400 >,
			<  998400 >,
			< 1094400 >,
			< 1209600 >;
};